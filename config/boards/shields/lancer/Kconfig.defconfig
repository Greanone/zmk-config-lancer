## config/boards/shields/lancer/Kconfig.defconfig
```kconfig
if SHIELD_LANCER

config ZMK_KEYBOARD_NAME
    default "Lancer"

    # Turn on deep sleep
CONFIG_ZMK_SLEEP=y
CONFIG_ZMK_IDLE_SLEEP_TIMEOUT=300000

CONFIG_ZMK_DISPLAY=y
CONFIG_ZMK_WIDGET_BATTERY_STATUS=y
CONFIG_ZMK_WIDGET_OUTPUT_STATUS=y
CONFIG_ZMK_WIDGET_WPM_STATUS=y

CONFIG_ZMK_DISPLAY_STATUS_SCREEN_BUILT_IN=y

CONFIG_ZMK_DISPLAY_WORK_QUEUE_SYSTEM=y

endif
```

## config/boards/shields/lancer/Kconfig.shield
```kconfig
config SHIELD_LANCER
    def_bool $(shields_list_contains,lancer)

   # Turn on deep sleep
 # CONFIG_ZMK_SLEEP=y
 # CONFIG_ZMK_IDLE_SLEEP_TIMEOUT=300000
```
